## conf/layer.conf
```bitbake
BBPATH .= ":${LAYERDIR}"

BBFILES += "\
    ${LAYERDIR}/recipes-*/*/*.bb \
    ${LAYERDIR}/recipes-*/*/*.bbappend \
"

BBFILE_COLLECTIONS += "meta-sunxi-extra"
BBFILE_PATTERN_meta-sunxi-extra = "^${LAYERDIR}/"
BBFILE_PRIORITY_meta-sunxi-extra = "12"

LAYERDEPENDS_meta-sunxi-extra += "sunxi"

LAYERSERIES_COMPAT_meta-sunxi-extra = "scarthgap styhead"
```

## conf/machine/olinuxino-a20-emmc.conf
```bitbake
require conf/machine/include/sun7i.inc

KERNEL_DEVICETREE="sun7i-a20-olinuxino-micro-emmc.dtb"
UBOOT_MACHINE="A20-OLinuXino_MICRO-eMMC_defconfig"

COMPATIBLE_MACHINE:olinuxino-a20-emmc = "olinuxino-a20-emmc"

PREFERRED_PROVIDER_virtual/kernel = "linux-yocto"
```
